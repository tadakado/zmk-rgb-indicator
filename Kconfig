## Kconfig
```kconfig
config ZMK_LED_STRIP_INDICATOR
    bool "Connection-status indicator LED strip proxy"
    default y
    depends on DT_HAS_ZMK_LED_STRIP_INDICATOR_ENABLED
    help
      A led_strip proxy that ZMK underglow writes to (chosen zmk,underglow).
      On an endpoint (central or non-split) it overrides one pixel with a color
      for the current USB/BLE endpoint, then forwards to the real strip. On a
      split peripheral it just forwards untouched.

config ZMK_LED_STRIP_INDICATOR_REFRESH_MS
    int "Re-send the last frame every this many ms (0 = never)"
    depends on ZMK_LED_STRIP_INDICATOR
    default 2000
    help
      WS2812 pixels hold their color until new data arrives, so if the strip
      gets glitched (e.g. data-line noise or a supply dip when the radio gets
      busy, such as a split half reconnecting) it stays wrong -- notably while
      underglow is off and nothing else writes to it. Periodically re-send the
      cached frame (with the indicator pixel) so it recovers on its own. A
      refresh is also sent shortly after every BLE connect / disconnect.

config ZMK_LED_STRIP_INDICATOR_TRACE
    bool "Log every frame forwarded to the strip (debug)"
    depends on ZMK_LED_STRIP_INDICATOR
    help
      Log each forward to the real strip: what triggered it (underglow frame or
      endpoint/profile event), the indicator pixel color sent, the endpoint seen
      and the led_strip_update_rgb() result. For chasing an indicator that
      blanks unexpectedly.
```

## dts/bindings/zmk,led-strip-indicator.yaml
```yaml
description: |
  LED strip proxy that overlays a connection-status indicator on one pixel and
  forwards every pixel to a target LED strip. Point `chosen { zmk,underglow }`
  at this node instead of the real strip.

compatible: "zmk,led-strip-indicator"

properties:
  target:
    type: phandle
    required: true
    description: The real LED strip device to forward to.
  chain-length:
    type: int
    required: true
    description: Number of pixels (must match the target strip).
  index:
    type: int
    default: 0
    description: Which pixel (0-based) shows the indicator.
  usb-color:
    type: int
    default: 0xff0000
    description: Indicator color (0xRRGGBB) when the USB endpoint is active.
  profile-colors:
    type: array
    default: [0x00ff00, 0x0000ff, 0xffff00, 0x00ffff, 0xff00ff]
    description: |
      Indicator colors (0xRRGGBB) per BLE profile, indexed by profile number
      (entry 0 = profile 0, ...). Defaults to green/blue/yellow/cyan/magenta.
      A profile beyond the end of the list shows nothing (off).
```
